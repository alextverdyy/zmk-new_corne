#include <behaviors.dtsi>
#include <behaviors/num_word.dtsi> // Requires auto-layer module.
#include <dt-bindings/zmk/keys.h>
#include <input/processors.dtsi>
#include <zephyr/dt-bindings/input/input-event-codes.h>
#ifdef CONFIG_WIRELESS
  #include <dt-bindings/zmk/bt.h>
  #include <dt-bindings/zmk/outputs.h>
  #define _BT_SEL_KEYS_                                                        \
      &bt BT_SEL 0 &bt BT_SEL 1 &bt BT_SEL 2 &bt BT_SEL 3 &bt BT_CLR
#else
  #define _BT_SEL_KEYS_ &trans &trans &trans &trans &trans
#endif

#include <dt-bindings/zmk/ext_power.h>
//Linux
#define HOST_OS 1
#include "zmk-helpers/helper.h"
#include "zmk-helpers/unicode-chars/greek.dtsi"
#include "zmk-helpers/unicode-chars/german.dtsi"

#define DEF 0
#define NAV 1
#define FN 2
#define NUM 3
#define SYS 4
#define MOUSE 5
#define NUMSYM 6
#define BUTTONS 7

#define XXX &none
#define ___ &trans


// macOS Keys and common shortcuts
#define MAC_LAUNCHPAD          C_AC_DESKTOP_SHOW_ALL_APPLICATIONS
#define MAC_LP                 MAC_LAUNCHPAD
#define MAC_MISSION_CONTROL    C_AC_DESKTOP_SHOW_ALL_WINDOWS
#define MAC_MC                 MAC_MISSION_CONTROL
#define MAC_SPOTLIGHT          C_AC_SEARCH
#define MAC_SP                 MAC_SPOTLIGHT
#define MAC_UNDO               LG(Z)
#define MAC_REDO               LG(LS(Z))
#define MAC_APP_WINDOWS        LG(LC(DOWN))   // Show windows from current application
#define MAC_APPWIN             MAC_APP_WINDOWS
#define MAC_NEXT_WINDOW        LG(GRAVE)      // Go to the next window on the same application
#define MAC_WINN               MAC_NEXT_WINDOW
#define MAC_PREVIOUS_WINDOW    LG(TILDE)      // Go to the previous window on the same application
#define MAC_WINP               MAC_PREVIOUS_WINDOW
#define MAC_NEXT_DESKTOP       LG(LC(RIGHT))  // Go to the next virtual desktop
#define MAC_DKTN               MAC_NEXT_DESKTOP
#define MAC_PREVIOUS_DESKTOP   LG(LC(LEFT))   // Go to the previous virtual desktop
#define MAC_DKTP               MAC_PREVIOUS_DESKTOP
#define MAC_FIND_NEXT          LG(G)
#define MAC_FDNXT              MAC_FIND_NEXT
#define MAC_FIND_PREVIOUS      LG(LS(G))
#define MAC_FDPRV              MAC_FIND_PREVIOUS
#define MAC_NEXT_WORD          LA(RIGHT)
#define MAC_WRDN               MAC_NEXT_WORD
#define MAC_PREVIOUS_WORD      LA(LEFT)
#define MAC_WRDP               MAC_PREVIOUS_WORD
#define MAC_START_OF_LINE      LG(LEFT)
#define MAC_STTL               MAC_START_OF_LINE
#define MAC_END_OF_LINE        LG(RIGHT)
#define MAC_ENDL               MAC_END_OF_LINE
#define UNDO_TOG_BUT_LAYER &kp MAC_UNDO



/* Global defaults */

#define QUICK_TAP_MS 175

&sk {
  release-after-ms = <900>;
  quick-release;
};

&sl { // Allow sticky mods to chord across sticky layers.
  ignore-modifiers;
};

&lt {
  flavor = "balanced";
  tapping-term-ms = <200>;
  quick-tap-ms = <QUICK_TAP_MS>;
};

/* Homerow mods */

#define KEYS_L LT0 LT1 LT2 LT3 LT4 LT5 LM0 LM1 LM2 LM3 LM4 LM5 LB0 LB1 LB2 LB3 LB4 LB5
#define KEYS_R RT0 RT1 RT2 RT3 RT4 RT5 RM0 RM1 RM2 RM3 RM4 RM5 RB0 RB1 RB2 RB3 RB4 RB5
#define THUMBS LH2 LH1 LH0 RH0 RH1 RH2 // Thumbs on 36+ keys.

#define MAKE_HRM(NAME, HOLD, TAP, TRIGGER_POS)                                 \
  ZMK_HOLD_TAP(NAME, bindings = <HOLD>, <TAP>; flavor = "balanced";            \
               tapping-term-ms = <280>; quick-tap-ms = <QUICK_TAP_MS>;         \
               require-prior-idle-ms = <150>; hold-trigger-on-release;         \
               hold-trigger-key-positions = <TRIGGER_POS>;)

MAKE_HRM(hml, &kp, &kp, KEYS_R THUMBS) // Left-hand HRMs.
MAKE_HRM(hmr, &kp, &kp, KEYS_L THUMBS) // Right-hand HRMs.

MAKE_HRM(hll, &mo, &kp, KEYS_R THUMBS) // Left-hand HRM - layer
MAKE_HRM(hlr, &mo, &kp, KEYS_L THUMBS) // Right-hand HRM - layer

// Hack: Make HRM combos tap-only (cf, ZMK issue #544).
#define ZMK_COMBO_8(NAME, TAP, POS, LAYERS, COMBO_MS, IDLE_MS, HOLD, SIDE)     \
  MAKE_HRM(hm_combo_##NAME, &kp, TAP, SIDE THUMBS)                             \
  ZMK_COMBO_6(NAME, &hm_combo_##NAME HOLD 0, POS, LAYERS, COMBO_MS, IDLE_MS)

/* Combos, leader key sequences, mouse emulation */

#include "combos.dtsi"
#include "mouse.dtsi"
#include "leader.dtsi"
#include "rgb.dtsi"

/* Nav cluster */

// Trigger tap-action on all interrupts.
#define MT_CORE                                                                \
  flavor = "tap-preferred";                                                    \
  tapping-term-ms = <220>;                                                     \
  quick-tap-ms = <220>;                                                        \
  hold-trigger-key-positions = <0>;

&mt { MT_CORE };

ZMK_HOLD_TAP(mt_home, bindings = <&masked_home>, <&kp>; MT_CORE)
ZMK_HOLD_TAP(mt_end, bindings = <&masked_end>, <&kp>; MT_CORE)

#define NAV_LEFT  &mt_home 0   LEFT  // Tap: left  | Long-tap: start of line.
#define NAV_RIGHT &mt_end 0    RIGHT // Tap: right | Long-tap: end   of line.
#define NAV_UP    &mt LC(HOME) UP    // Tap: up    | Long-tap: start of doc.
#define NAV_DOWN  &mt LC(END)  DOWN  // Tap: down  | Long-tap: end   of doc.
#define NAV_BSPC  &mt LC(BSPC) BSPC  // Tap: bspc  | Long-tap: delete word bwd.
#define NAV_DEL   &mt LC(DEL)  DEL   // Tap: del   | Long-tap: delete word fwd.

// Mask CTRL on left/right hold to avoid accidental jumps to start/end of doc.
#define MASK_MODS(NAME, MODS, BINDING)                                         \
  ZMK_MOD_MORPH(NAME, bindings = <BINDING>, <BINDING>; mods = <MODS>;)

MASK_MODS(masked_home, (MOD_LCTL), &kp HOME)
MASK_MODS(masked_end,  (MOD_LCTL), &kp END)

/* Magic-shift & auto-layers */

// Tap: repeat after alpha, else sticky-shift |
// Shift + tap/ double-tap: caps-word | Hold: shift.
#define MAGIC_SHIFT &magic_shift LSHFT 0
ZMK_HOLD_TAP(magic_shift, bindings = <&kp>, <&magic_shift_tap>;
             flavor = "balanced"; tapping-term-ms = <200>;
             quick-tap-ms = <QUICK_TAP_MS>;)
ZMK_MOD_MORPH(magic_shift_tap, bindings = <&shift_repeat>, <&caps_word>;
              mods = <(MOD_LSFT)>;)
ZMK_ADAPTIVE_KEY(
    shift_repeat, bindings = <&sk LSHFT>;
    repeat {
      trigger-keys = <A B C D E F G H I J K L M N O P Q R S T U V W X Y Z>;
      bindings = <&key_repeat>;
      max-prior-idle-ms = <1200>;
      strict-modifiers;
    };)
&caps_word { // Mods deactivate caps-word, requires PR #1451. [TODO: rebase]
  /delete-property/ ignore-modifiers;
};

// Tap: num-word | double-tap: sticky num-layer | Hold: num-layer.
#define SMART_NUM &smart_num NUM 0
ZMK_HOLD_TAP(smart_num, bindings = <&mo>, <&num_dance>; flavor = "balanced";
             tapping-term-ms = <200>; quick-tap-ms = <QUICK_TAP_MS>;)
ZMK_TAP_DANCE(num_dance, bindings = <&num_word NUM>, <&sl NUM>;
              tapping-term-ms = <200>;)

// Smart-mouse, requires tri-state module.
ZMK_TRI_STATE(
    smart_mouse, bindings = <&tog MOUSE>, <&none>, <&tog MOUSE>;
    ignored-key-positions =
        <LT1 LT2 LH0 LH1 RT1 RT2 RT3 RM0 RM1 RM2 RM3 RM4 RB1 RB2 RB3 RH0 RH1 JS0 JS1 JS2 JS3 JS4>;
    ignored-layers = <MOUSE NAV FN>;)

/* Custom behaviors */

// Alt+Tab swapper, requires tri-state module.
ZMK_TRI_STATE(swapper, bindings = <&kt LGUI>, <&kp TAB>, <&kt LGUI>;
              ignored-key-positions = <LT2 RT2 RM1 RM2 RM3>;)

// Define mod-morph with a *single* mod trigger for less repetition.
#define SIMPLE_MORPH(NAME, MOD, BINDING1, BINDING2)                            \
  ZMK_MOD_MORPH(NAME, mods = <(MOD_L##MOD | MOD_R##MOD)>;                      \
                bindings = <BINDING1>, <BINDING2>;)

// Tap: comma | Shift + tap: semicolon | Ctrl + shift + tap: <.
SIMPLE_MORPH(comma_morph, SFT, &kp COMMA, &comma_inner_morph)
SIMPLE_MORPH(comma_inner_morph, CTL, &kp SEMICOLON, &kp LESS_THAN)

// Tap: dot | Shift + tap: colon | Ctrl + shift + tap: >.
SIMPLE_MORPH(dot_morph, SFT, &kp DOT, &dot_inner_morph)
SIMPLE_MORPH(dot_inner_morph, CTL, &kp COLON, &kp GREATER_THAN)

// Tap: qmark | Shift + tap: excl.
SIMPLE_MORPH(qexcl, SFT, &kp QMARK, &kp EXCL)

// Tap: left/right parenthesis | Shft + tap: less-than/greater-than.
SIMPLE_MORPH(lpar_lt, SFT, &kp LPAR, &kp LT)
SIMPLE_MORPH(rpar_gt, SFT, &kp RPAR, &kp GT)

// Tap: space | Shift + tap: dot -> space -> sticky shift | Hold: nav layer.
ZMK_HOLD_TAP(lt_spc, bindings = <&mo>, <&spc_morph>; flavor = "balanced";
             tapping-term-ms = <200>; quick-tap-ms = <QUICK_TAP_MS>;)
SIMPLE_MORPH(spc_morph, SFT, &kp SPACE, &dot_spc)
ZMK_MACRO(dot_spc, bindings = <&kp DOT &kp SPACE &sk LSHFT>; wait-ms = <0>;
          tap-ms = <5>;)

// Tap: backspace | Lshft + tap: delete | Rshft + tap: shift-delete.
ZMK_MOD_MORPH(bs_del, bindings = <&kp BSPC>, <&kp DEL>;
              mods = <(MOD_LSFT|MOD_RSFT)>; keep-mods = <MOD_RSFT>;)

// Tap: copy | double-tap: cut.
ZMK_TAP_DANCE(copy_cut, bindings = <&kp LC(INS)>, <&kp LC(X)>;
              tapping-term-ms = <200>;)
// Tap: copy | double-tap: cut.
ZMK_TAP_DANCE(tap_test, bindings = <&kp O>, <&kp T>;
                            tapping-term-ms = <200>;)
// Sticky shift + leader.
ZMK_MACRO(leader_sft, bindings = <&sk LSHFT &leader>;)

// Misc aliases. [TODO: clean up]
#define CANCEL    &kp K_CANCEL            // Cancel caps-word & auto-layers.
#define DSK_PREV  &hmr LCTRL LG(LC(LEFT)) // Previous desktop.
#define DSK_NEXT  &hmr LALT LG(LC(RIGHT)) // Next     desktop.
#define PIN_WIN   &kp LG(LC(LS(Q)))       // Pin window across desktops.
#define PIN_APP   &kp LG(LC(LS(A)))       // Pin application across desktops.
#define DSK_MGR   &kp LA(GRAVE)           // Desktop manager.
#define VOL_DOWN  &hmr RSHFT C_VOL_DN
#define Z_BUT  &hll BUTTONS Z
#define FSLH_BUT  &hlr BUTTONS FSLH

/* Keymap */

ZMK_CONDITIONAL_LAYER(sys, FN NUM, SYS) // FN + NUM --> SYS.

#ifndef ZMK_BASE_LAYER
  #define ZMK_BASE_LAYER(name, LT, RT, LM, RM, LB, RB, LH, RH, LS0, LS13, LS4, sensors))                 \
      ZMK_LAYER(name, LT RT LM RM LB RB LH RH LS0 LS13 LS4 sensors)
#endif

ZMK_BASE_LAYER(Base,
// ╭───────────────┬───────────────┬───────────────┬───────────────┬───────────────┬───────────────╮          ╭───────────────┬───────────────┬───────────────┬───────────────┬───────────────┬───────────────╮
    &kp ESC         &kp Q          &kp W         &kp E          &kp R           &kp T           ,               &kp Y           &kp U           &kp I           &kp O           &kp P           &kp DEL        ,
// ├───────────────┼───────────────┼───────────────┼───────────────┼───────────────┼───────────────┤          ├───────────────┼───────────────┼───────────────┼───────────────┼───────────────┼───────────────┤
    &kp TAB         &hml LCTRL A     &hml LALT S      &hml LGUI D    &hml LSHFT F   &kp G          ,            &kp H           &hmr RSHFT J    &hmr LGUI K    &hmr LALT L     &hmr LCTRL SEMI     &kp SQT          ,
// ├───────────────┼───────────────┼───────────────┼───────────────┼───────────────┼───────────────┤          ├───────────────┼───────────────┼───────────────┼───────────────┼───────────────┼───────────────┤
     &kp LCTRL       Z_BUT           &kp X           &kp C           &kp V           &kp B          ,           &kp N           &kp M           &comma_morph    &dot_morph      FSLH_BUT           &qexcl         ,
// ╰───────────────┴───────────────┴───────────────┼───────────────┼───────────────┼───────────────┤          ├───────────────┼───────────────┼───────────────┼───────────────┴───────────────┴───────────────╯
                                        	    MAGIC_SHIFT      &lt_spc NAV 0  &lt SYS ESC     ,          &lt FN RET      &lt NUMSYM BSPC    SMART_NUM      ,
                                                 //╰───────────────┴───────────────┴───────────────╯          ╰───────────────┴───────────────┴───────────────╯
                                                 // ╭───────────────┬───────────────┬───────────────╮
                                                                      &kp UP                        ,
                                                 // ├───────────────┼───────────────┼───────────────┤
                                                     &kp LEFT         &kp ENTER         &kp RIGHT   ,
                                                 // ├───────────────┼───────────────┼───────────────┤
                                                     &kp C_PLAY_PAUSE &kp DOWN                     ,
                                                 // ╰───────────────┴───────────────┴───────────────╯
&inc_dec_kp C_VOLUME_UP C_VOLUME_DOWN
)

ZMK_BASE_LAYER(Nav,
// ╭───────────────┬───────────────┬───────────────┬───────────────┬───────────────┬───────────────╮          ╭───────────────┬───────────────┬───────────────┬───────────────┬───────────────┬───────────────╮
     ___            &kp LA(F4)      ___             &kp LS(TAB)     &swapper        ___            ,           &kp PG_UP       NAV_BSPC        NAV_UP          NAV_DEL         ___             ___            ,
// ├───────────────┼───────────────┼───────────────┼───────────────┼───────────────┼───────────────┤          ├───────────────┼───────────────┼───────────────┼───────────────┼───────────────┼───────────────┤
     ___            &sk LCTRL        &sk LALT        &sk LGUI       &sk LSHFT       ___            ,           &kp PG_DN       NAV_LEFT        NAV_DOWN        NAV_RIGHT       &kp RET         ___            ,
// ├───────────────┼───────────────┼───────────────┼───────────────┼───────────────┼───────────────┤          ├───────────────┼───────────────┼───────────────┼───────────────┼───────────────┼───────────────┤
     ___            ___             ___             &kp MAC_UNDO    &kp MAC_REDO    ___            ,           &kp INS         &kp TAB         ___             ___             ___             ___            ,
// ╰───────────────┴───────────────┴───────────────┼───────────────┼───────────────┼───────────────┤          ├───────────────┼───────────────┼───────────────┼───────────────┴───────────────┴───────────────╯
                                                    ___             ___             ___            ,           ___             CANCEL          ___            ,
                                                 //╰───────────────┴───────────────┴───────────────╯          ╰───────────────┴───────────────┴───────────────╯
                                                  // ╭───────────────┬───────────────┬───────────────╮
                                                                       ___                           ,
                                                  // ├───────────────┼───────────────┼───────────────┤
                                                      ___             ___             ___            ,
                                                  // ├───────────────┼───────────────┼───────────────┤
                                                      ___             ___                           ,
                                                  // ╰───────────────┴───────────────┴───────────────╯
&inc_dec_kp C_VOLUME_UP C_VOLUME_DOWN
)

ZMK_BASE_LAYER(Fn,
// ╭───────────────┬───────────────┬───────────────┬───────────────┬───────────────┬───────────────╮          ╭───────────────┬───────────────┬───────────────┬───────────────┬───────────────┬───────────────╮
     ___            &kp F12         &kp F7          &kp F8          &kp F9          ___            ,           ___             &kp C_PREV      &kp C_VOL_UP    &kp C_NEXT      ___             ___            ,
// ├───────────────┼───────────────┼───────────────┼───────────────┼───────────────┼───────────────┤          ├───────────────┼───────────────┼───────────────┼───────────────┼───────────────┼───────────────┤
     ___            &hml LCTRL F11   &hml LALT F4    &hml LGUI F5   &hml LSHFT F6   ___            ,           ___             DSK_PREV        VOL_DOWN        DSK_NEXT        ___             ___            ,
// ├───────────────┼───────────────┼───────────────┼───────────────┼───────────────┼───────────────┤          ├───────────────┼───────────────┼───────────────┼───────────────┼───────────────┼───────────────┤
     ___            &kp F10         &kp F1          &kp F2          &kp F3          ___            ,           PIN_APP         PIN_WIN         DSK_MGR         ___             ___             ___            ,
// ╰───────────────┴───────────────┴───────────────┼───────────────┼───────────────┼───────────────┤          ├───────────────┼───────────────┼───────────────┼───────────────┴───────────────┴───────────────╯
                                                    ___             ___             ___            ,           &kp C_MUTE      &kp C_PP        ___            ,
                                                 //╰───────────────┴───────────────┴───────────────╯          ╰───────────────┴───────────────┴───────────────╯
                                                  // ╭───────────────┬───────────────┬───────────────╮
                                                                       ___                           ,
                                                  // ├───────────────┼───────────────┼───────────────┤
                                                      ___             ___             ___            ,
                                                  // ├───────────────┼───────────────┼───────────────┤
                                                      ___             ___                            ,
                                                  // ╰───────────────┴───────────────┴───────────────╯
&inc_dec_kp C_VOLUME_UP C_VOLUME_DOWN
)

ZMK_BASE_LAYER(Num,
// ╭───────────────┬───────────────┬───────────────┬───────────────┬───────────────┬───────────────╮          ╭───────────────┬───────────────┬───────────────┬───────────────┬───────────────┬───────────────╮
     ___            ___             &kp N7          &kp N8          &kp N9          ___            ,           ___             &kp N7          &kp N8          &kp N9          ___             ___            ,
// ├───────────────┼───────────────┼───────────────┼───────────────┼───────────────┼───────────────┤          ├───────────────┼───────────────┼───────────────┼───────────────┼───────────────┼───────────────┤
     ___            &hml LCTRL N0    &hml LALT N4    &hml LSHFT N5   &hml LGUI N6   ___            ,           ___             &hmr RCTRL N4   &hmr RSHFT N5   &hmr LALT N6    &hmr LGUI N0    ___            ,
// ├───────────────┼───────────────┼───────────────┼───────────────┼───────────────┼───────────────┤          ├───────────────┼───────────────┼───────────────┼───────────────┼───────────────┼───────────────┤
     ___            ___             &kp N1          &kp N2          &kp N3          ___            ,           ___             &kp N1          &kp N2          &kp N3          ___             ___            ,
// ╰───────────────┴───────────────┴───────────────┼───────────────┼───────────────┼───────────────┤          ├───────────────┼───────────────┼───────────────┼───────────────┴───────────────┴───────────────╯
                                                    ___             ___             ___            ,           ___             ___             ___            ,
                                                 //╰───────────────┴───────────────┴───────────────╯          ╰───────────────┴───────────────┴───────────────╯
                                                  // ╭───────────────┬───────────────┬───────────────╮
                                                                       ___                           ,
                                                  // ├───────────────┼───────────────┼───────────────┤
                                                      ___             ___             ___            ,
                                                  // ├───────────────┼───────────────┼───────────────┤
                                                      ___             ___                            ,
                                                  // ╰───────────────┴───────────────┴───────────────╯
&inc_dec_kp C_VOLUME_UP C_VOLUME_DOWN
)

ZMK_BASE_LAYER(Sys,
// ╭───────────────┬───────────────┬───────────────┬───────────────┬───────────────┬───────────────╮          ╭───────────────┬───────────────┬───────────────┬───────────────┬───────────────┬───────────────╮
     &bt BT_SEL 0   &bt BT_SEL 1    &bt BT_SEL 2    &bt BT_SEL 3    &bt BT_SEL 4    &bt BT_CLR     ,           ___            ___             ___             ___             ___             ___            ,
// ├───────────────┼───────────────┼───────────────┼───────────────┼───────────────┼───────────────┤          ├───────────────┼───────────────┼───────────────┼───────────────┼───────────────┼───────────────┤
    CRGB_ON         CRGB_HUI        CRGB_SAI        CRGB_BRI        CRGB_SPI        &bootloader    ,           &bootloader     CRGB_EFF        ___             ___             ___             ___            ,
// ├───────────────┼───────────────┼───────────────┼───────────────┼───────────────┼───────────────┤          ├───────────────┼───────────────┼───────────────┼───────────────┼───────────────┼───────────────┤
    CRGB_OFF        CRGB_HUD        CRGB_SAD        CRGB_BRD        CRGB_SPD        &sys_reset     ,           &sys_reset      CRGB_EFR        ___             ___             ___             ___            ,
// ╰───────────────┴───────────────┴───────────────┼───────────────┼───────────────┼───────────────┤          ├───────────────┼───────────────┼───────────────┼───────────────┴───────────────┴───────────────╯
                                                    ___             ___             ___            ,           ___             ___             ___            ,
                                                 //╰───────────────┴───────────────┴───────────────╯          ╰───────────────┴───────────────┴───────────────╯
                                                  // ╭───────────────┬───────────────┬───────────────╮
                                                                       ___                           ,
                                                  // ├───────────────┼───────────────┼───────────────┤
                                                      ___             ___             ___            ,
                                                  // ├───────────────┼───────────────┼───────────────┤
                                                      ___             ___                            ,
                                                  // ╰───────────────┴───────────────┴───────────────╯
&inc_dec_kp C_VOLUME_UP C_VOLUME_DOWN
)

ZMK_BASE_LAYER(Mouse,
// ╭───────────────┬───────────────┬───────────────┬───────────────┬───────────────┬───────────────╮          ╭───────────────┬───────────────┬───────────────┬───────────────┬───────────────┬───────────────╮
     ___            ___             ___             ___             ___             ___            ,           ___             &kp PG_UP       U_MS_U          &kp PG_DN       ___             ___            ,
// ├───────────────┼───────────────┼───────────────┼───────────────┼───────────────┼───────────────┤          ├───────────────┼───────────────┼───────────────┼───────────────┼───────────────┼───────────────┤
     ___            ___             ___             ___             ___             ___            ,           U_WH_L          U_MS_L          U_MS_D          U_MS_R          U_WH_R          ___            ,
// ├───────────────┼───────────────┼───────────────┼───────────────┼───────────────┼───────────────┤          ├───────────────┼───────────────┼───────────────┼───────────────┼───────────────┼───────────────┤
     ___            ___             ___             ___             ___             ___            ,           ___             &mkp LCLK       &mkp MCLK       &mkp RCLK       ___             ___            ,
// ╰───────────────┴───────────────┴───────────────┼───────────────┼───────────────┼───────────────┤          ├───────────────┼───────────────┼───────────────┼───────────────┴───────────────┴───────────────╯
                                                    ___             ___             ___            ,           U_WH_U          U_WH_D          ___            ,
                                                 //╰───────────────┴───────────────┴───────────────╯          ╰───────────────┴───────────────┴───────────────╯
                                                  // ╭───────────────┬───────────────┬───────────────╮
                                                                      U_MS_U                        ,
                                                  // ├───────────────┼───────────────┼───────────────┤
                                                      U_MS_L          &mkp LCLK           U_MS_R    ,
                                                  // ├───────────────┼───────────────┼───────────────┤
                                                      &kp SPACE          U_MS_D                       ,
                                                  // ╰───────────────┴───────────────┴───────────────╯
&inc_dec_kp C_VOLUME_UP C_VOLUME_DOWN
)

ZMK_BASE_LAYER(Numsym,
// ╭───────────────┬───────────────┬───────────────┬───────────────┬───────────────┬───────────────╮          ╭───────────────┬───────────────┬───────────────┬───────────────┬───────────────┬───────────────╮
        ___           ___           &kp N7              &kp N8        &kp N9        &kp STAR       ,            &kp EXCL      &kp LBKT        &kp RBKT        &kp DLLR         &kp PIPE             ___       ,
// ├───────────────┼───────────────┼───────────────┼───────────────┼───────────────┼───────────────┤          ├───────────────┼───────────────┼───────────────┼───────────────┼───────────────┼───────────────┤
        ___           &sk LCTRL      &hml LALT N4     &hml LGUI N5   &hml LSHFT N6   &kp FSLH      ,            &kp AT        &hml LSHFT LPAR &hml LGUI RPAR  &hml LALT PRCNT &hml LCTRL AMPS  &kp GRAVE      ,
// ├───────────────┼───────────────┼───────────────┼───────────────┼───────────────┼───────────────┤          ├───────────────┼───────────────┼───────────────┼───────────────┼───────────────┼───────────────┤
        ___           ___             &kp N1          &kp N2         &kp N3         &kp DOT        ,            &kp HASH      &kp LBRC        &kp RBRC        &kp CARET        &kp BSLH             ___       ,
// ╰───────────────┴───────────────┴───────────────┼───────────────┼───────────────┼───────────────┤          ├───────────────┼───────────────┼───────────────┼───────────────┴───────────────┴───────────────╯
                                                             ___      &kp N0             ___       ,                ___           ___           ___         ,
                                                 //╰───────────────┴───────────────┴───────────────╯          ╰───────────────┴───────────────┴───────────────╯
                                                  // ╭───────────────┬───────────────┬───────────────╮
                                                                      U_MS_U                        ,
                                                  // ├───────────────┼───────────────┼───────────────┤
                                                      U_MS_L          &mkp LCLK           U_MS_R    ,
                                                  // ├───────────────┼───────────────┼───────────────┤
                                                      &kp SPACE          U_MS_D                       ,
                                                  // ╰───────────────┴───────────────┴───────────────╯
&inc_dec_kp C_VOLUME_UP C_VOLUME_DOWN
)


ZMK_BASE_LAYER(Buttons,
// ╭───────────────┬───────────────┬───────────────┬───────────────┬───────────────┬───────────────╮          ╭───────────────┬───────────────┬───────────────┬───────────────┬───────────────┬───────────────╮
        &none       &kp MAC_DKTP &kp MAC_WINP  &kp MAC_WINN      &kp MAC_DKTN   &kp MAC_APPWIN,  		&kp MAC_APPWIN &kp MAC_DKTP  &kp MAC_WINP  &kp MAC_WINN  &kp MAC_DKTN &kp RG(PLUS),
// ├───────────────┼───────────────┼───────────────┼───────────────┼───────────────┼───────────────┤   	      ┼───────────────┼───────────────┼───────────────┼───────────────┼───────────────┤
        &none       &kp LCTRL    &kp LALT     &kp LGUI           &kp LSHFT     &kp MAC_MC,      		&kp MAC_MC     &kp LSHFT     &kp LGUI        &kp LALT         &kp LCTRL    &kp RG(MINUS),
// ├───────────────┼───────────────┼───────────────┼───────────────┼───────────────┼───────────────┤   	      ┼───────────────┼───────────────┼───────────────┼───────────────┼───────────────┤
   &mt GLOBE MAC_REDO UNDO_TOG_BUT_LAYER    &kp MAC_CUT   &kp MAC_COPY   &kp MAC_PASTE    &kp MAC_SP,    	&kp MAC_SP     &kp MAC_PASTE &kp MAC_COPY  &kp MAC_CUT   UNDO_TOG_BUT_LAYER  &mt GLOBE MAC_REDO,
// ╰───────────────┴───────────────┴───────────────┼───────────────┼───────────────┼───────────────┤          ├───────────────┼───────────────┼───────────────┼───────────────┴───────────────┴───────────────╯
                                                             ___      ___             ___       ,                ___           ___           ___         ,
                                                 //╰───────────────┴───────────────┴───────────────╯          ╰───────────────┴───────────────┴───────────────╯
                                                  // ╭───────────────┬───────────────┬───────────────╮
                                                                      U_MS_U                        ,
                                                  // ├───────────────┼───────────────┼───────────────┤
                                                      U_MS_L          &mkp LCLK           U_MS_R    ,
                                                  // ├───────────────┼───────────────┼───────────────┤
                                                      &kp SPACE          U_MS_D                       ,
                                                  // ╰───────────────┴───────────────┴───────────────╯
&inc_dec_kp C_VOLUME_UP C_VOLUME_DOWN
)
